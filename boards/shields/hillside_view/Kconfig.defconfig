## boards/shields/hillside_view/Kconfig.defconfig
```kconfig
# Copyright (c) 2022 The ZMK Contributors
# SPDX-License-Identifier: MIT

if SHIELD_HILLSIDE_VIEW_LEFT

config ZMK_KEYBOARD_NAME
    default "Hillside View"

config ZMK_SPLIT_ROLE_CENTRAL
    default y

config ZMK_USB
    default y

endif # SHIELD_HILLSIDE_VIEW_LEFT

if SHIELD_HILLSIDE_VIEW_LEFT_FLIP

config ZMK_KEYBOARD_NAME
    default "Hillside View Flip"

config ZMK_SPLIT_ROLE_CENTRAL
    default y

config ZMK_USB
    default y

endif # SHIELD_HILLSIDE_VIEW_LEFT_FLIP

if SHIELD_HILLSIDE_VIEW_LEFT || SHIELD_HILLSIDE_VIEW_RIGHT || SHIELD_HILLSIDE_VIEW_LEFT_FLIP || SHIELD_HILLSIDE_VIEW_RIGHT_FLIP

config ZMK_SPLIT
    default y

config ZMK_RGB_UNDERGLOW
    select WS2812_STRIP
    select SPI

config ZMK_DISPLAY
    select LV_FONT_MONTSERRAT_26

if ZMK_POINTING

config I2C
  default y

endif # ZMK_POINTING

if ZMK_DISPLAY

config ZMK_DISPLAY_BLANK_ON_IDLE
  default n

config SPI
    default y

config LS0XX
    default y

# config ZMK_WIDGET_WPM_STATUS
#   default y if !ZMK_SPLIT || ZMK_SPLIT_ROLE_CENTRAL

config LV_Z_BITS_PER_PIXEL
    default 1

choice LV_COLOR_DEPTH
    default LV_COLOR_DEPTH_1
endchoice

endif # ZMK_DISPLAY

if LVGL

config LV_Z_VDB_SIZE
    default 100

config LV_DPI_DEF
    default 161

config LV_Z_BITS_PER_PIXEL
    default 1

choice LV_COLOR_DEPTH
    default LV_COLOR_DEPTH_1

endchoice

endif # LVGL

endif # SHIELD_HILLSIDE_VIEW_LEFT || SHIELD_HILLSIDE_VIEW_RIGHT || SHIELD_HILLSIDE_VIEW_LEFT_FLIP || SHIELD_HILLSIDE_VIEW_RIGHT_FLIP
```

## boards/shields/hillside_view/Kconfig.shield
```kconfig
# Copyright (c) 2022 The ZMK Contributors
# SPDX-License-Identifier: MIT

config SHIELD_HILLSIDE_VIEW_LEFT
    def_bool $(shields_list_contains,hillside_view_left)

config SHIELD_HILLSIDE_VIEW_RIGHT
    def_bool $(shields_list_contains,hillside_view_right)

config SHIELD_HILLSIDE_VIEW_LEFT_FLIP
    def_bool $(shields_list_contains,hillside_view_left_flip)

config SHIELD_HILLSIDE_VIEW_RIGHT_FLIP
    def_bool $(shields_list_contains,hillside_view_right_flip)
```

## boards/shields/klor/Kconfig.shield
```kconfig
# Copyright (c) 2022 GEIST
# SPDX-License-Identifier: MIT

config SHIELD_KLOR_LEFT
    def_bool $(shields_list_contains,klor_left)

config SHIELD_KLOR_RIGHT
    def_bool $(shields_list_contains,klor_right)
```

## boards/shields/totem/Kconfig.shield
```kconfig
# Copyright (c) 2020 Pete Johanson
# SPDX-License-Identifier: MIT

config SHIELD_TOTEM_LEFT
    def_bool $(shields_list_contains,totem_left)

config SHIELD_TOTEM_RIGHT
    def_bool $(shields_list_contains,totem_right)
```
