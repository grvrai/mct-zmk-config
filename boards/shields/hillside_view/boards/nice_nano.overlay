/*
 * Copyright (c) 2024 The ZMK Contributors
 *
 * SPDX-License-Identifier: MIT
 *
 * Override battery sensing to use external voltage divider instead of VDDHDIV5.
 * This provides more accurate battery readings on some nice!nano v2 boards
 * where the internal VDDH rail doesn't accurately reflect battery voltage.
 */

/ {
    chosen {
        zmk,battery = &vbatt;
    };

    vbatt: vbatt {
        compatible = "zmk,battery-voltage-divider";
        io-channels = <&adc 2>;
        output-ohms = <2000000>;
        full-ohms = <(2000000 + 806000)>;
    };
};
